## drivers/ckernel/Kconfig
```kconfig
config CKERNEL_DRIVER
	tristate "CKernel driver"
	depends on USER_NS
	depends on PROC_FS
	depends on NET
	depends on RESCTRL_FS
	depends on ARM64_MPAM
	depends on CGROUP_SCHED
	depends on CFS_BANDWIDTH
	select FAASCALE_MEMORY if MEMCG && MIGRATION && MMU
	default m
	help
	  Experimental kernel extension framework.
	  Provides a per-task context with lifecycle hooks,
	  along with ioctl, procfs and debugfs interfaces.
```

## kernel/ckernel_m/Kconfig
```kconfig
config CKERNEL_M
	bool "Experimental CKernel-M instance ownership"
	depends on CGROUPS && MEMCG_KMEM && NUMA && 64BIT
	default n
	help
	  Host-controlled ownership contexts for opt-in kernel state locality.
	  This is experimental and does not provide a kernel security boundary.
	  No application is enrolled unless a privileged control handle binds it.

config CKERNEL_M_MAPLE
	bool "CKernel-M bounded Maple inventory"
	depends on CKERNEL_M && NUMA && SLUB && MEMCG_KMEM
	default n
	help
	  Experimental owner-aware inventory for explicitly attached mm trees.
	  Reuse is bounded by instance, CPU and NUMA limits. Unsupported contexts
	  use the native allocator; this option does not guarantee lower latency.

config CKERNEL_M_VFS
	bool "CKernel-M terminal dentry reference loans"
	depends on CKERNEL_M && TMPFS
	default n
	help
	  Opt-in, bounded reference loans for a registered read-only tmpfs mount.
	  Native path traversal, permissions and mount references remain intact.
	  This experimental prototype adds instance-local read-side locking and
	  does not imply faster pathname lookup or a security boundary.

config CKERNEL_M_VFS_OPEN
	bool "CKernel-M read-only open-file dentry loans"
	depends on CKERNEL_M_VFS
	default n
	help
	  Borrow a terminal dentry reference for independently opened read-only
	  files on the registered tmpfs mount. All permission checks and file
	  state remain native. Adds an ownership pointer to struct file.

config CKERNEL_M_SECURITY
	bool "CKernel-M bounded AppArmor label reference loans"
	depends on CKERNEL_M && SECURITY_APPARMOR
	default n
	help
	  Instance-local label references and native-equivalent unmediated self
	  signal qualification. Native file decisions, audits and other LSMs
	  remain active. Full caches and unsupported conditions use native paths.

config CKERNEL_M_SECURITY_KUNIT_TEST
	bool "CKernel-M AppArmor subject equivalence tests"
	depends on KUNIT && CKERNEL_M_SECURITY
	default n

config CKERNEL_M_FD
	bool "CKernel-M bounded legacy FD quota delegation"
	depends on CKERNEL_M && CGROUP_FILES
	default n
	help
	  Delegate at most 64 precharged idle FD credits to one enrolled instance
	  per non-root legacy files cgroup. Preserve native usage and ancestor
	  limits through explicit drain coordination. Misc mode is unsupported.
	  This prototype may increase control-path latency and is not accepted
	  as an isolation guarantee. Unlimited groups are still accounted.

config CKERNEL_M_KUNIT_TEST
	bool "CKernel-M core tests" if !KUNIT_ALL_TESTS
	depends on KUNIT && CKERNEL_M=y
	default KUNIT_ALL_TESTS
	help
	  Test the ABI layout and, when Maple inventory is enabled, basic owner
	  separation, capacity and retirement. These tests are not performance
	  acceptance or a complete substitute for VM lifecycle regressions.
```
